/dts-v1/;
/plugin/;

/ {
	compatible = "ubiquiti,edgerouter-x";
	model = "Ubiquiti EdgeRouter X";

	fragment@0 {
		target-path = "/ethernet@1e100000";
		__overlay__ {
			#address-cells = <1>;
			#size-cells = <0>;
			mediatek,ethsys = <&ethsys>;
		};
	};
	fragment@1 {
		target-path = "/gsw@1e110000";
		__overlay__ {
			interrupt-parent = <&gic>;
			interrupts = <0 23 4>;
			interrupt-names = "gsw";
		};
	};
	fragment@2 {
		target-path = "/nand@1e003000/partition@740000";
		#address-cells = <1>;
		#size-cells = <1>;
		__overlay__ {
			reg = <0x740000 0xf7c0000>;
		};
	};
};
